## app/drivers/joystick_mouse/Kconfig
```kconfig
menuconfig JOYSTICK_MOUSE
    bool "Joystick Mouse Driver"
    default y
    help
        Enable joystick as mouse driver

if JOYSTICK_MOUSE

config JOYSTICK_POLLING_INTERVAL
    int "Joystick polling interval (ms)"
    default 20
    range 10 100
    help
        Interval in milliseconds between joystick readings

config JOYSTICK_DEADZONE
    int "Joystick deadzone"
    default 100
    range 0 500
    help
        ADC deadzone to ignore small movements

config JOYSTICK_SPEED
    int "Mouse speed multiplier"
    default 5
    range 1 20
    help
        Speed multiplier for mouse movement

endif
```

## config/Kconfig.defconfig
```kconfig
# Copyright (c) 2020 Ryan Cross
# SPDX-License-Identifier: MIT

if SHIELD_SOFLE_LEFT

config ZMK_KEYBOARD_NAME
    default "Sofle"

config ZMK_POINTING
    default y

config ADC
    default y

config ADC_ASYNC
    default y

config ANALOG_INPUT
    default y

config ANALOG_INPUT_LOG_DBG_RAW
    default y

config ANALOG_INPUT_LOG_DBG_REPORT
    default y

config ZMK_SPLIT_ROLE_CENTRAL
    default y

endif

if USB

config USB_NRFX
	default y

config USB_DEVICE_STACK
	default y

endif # USB

if SHIELD_SOFLE_LEFT || SHIELD_SOFLE_RIGHT

config ZMK_SPLIT
    default y

if ZMK_DISPLAY

config I2C
    default y

config SSD1306
    default y

endif # ZMK_DISPLAY

if LVGL

config LV_Z_VDB_SIZE
    default 64

config LV_DPI_DEF
    default 148

config LV_Z_BITS_PER_PIXEL
    default 1

choice LV_COLOR_DEPTH
    default LV_COLOR_DEPTH_1
endchoice

endif # LVGL

endif


# Copyright (c) 2020 The ZMK Contributors
# SPDX-License-Identifier: MIT
```

## config/west.yml
```yaml
manifest:
  remotes:
    - name: zmkfirmware
      url-base: https://github.com/zmkfirmware
    - name: badjeff
      url-base: https://github.com/badjeff/
    # Additional modules containing boards/shields/custom code can be listed here as well
    # See https://docs.zephyrproject.org/3.2.0/develop/west/manifest.html#projects
  projects:
    - name: zmk
      remote: zmkfirmware
      revision: main
      import: app/west.yml
    - name: zmk-analog-input-driver
      remote: badjeff
      revision: main
  self:
    path: config



# manifest:
#   remotes:
#     - name: zmkfirmware
#       url-base: https://github.com/zmkfirmware
#     - name: badjeff
#       url-base: https://github.com/badjeff/
#     - name: yourgithub
#       url-base: https://github.com/yourgithub/
#   projects:
#     - name: zmk
#       remote: zmkfirmware
#       revision: main
#       import: app/west.yml
#     - name: zmk-analog-input-driver
#       remote: badjeff
#       revision: main
#     - name: zephyr
#       remote: yourgithub
#       revision: main
#   self:
#     path: config
```
