/dts-v1/;
/plugin/;

#include <dt-bindings/adc/adc.h>

&adc {
	status = "okay";
	
	#address-cells = <1>;
	#size-cells = <0>;
	
	// 通道0: 摇杆X轴
	channel@0 {
		reg = <0>;
		zephyr,gain = "ADC_GAIN_1_5";
		zephyr,reference = "ADC_REF_INTERNAL";
		zephyr,acquisition-time = <ADC_ACQ_TIME(ADC_ACQ_TIME_MICROSECONDS, 40)>;
		zephyr,resolution = <12>;
		zephyr,input-positive = <NRF_SAADC_AIN0>;  // P0.02
		label = "JOYSTICK_X";
	};
	
	// 通道1: 摇杆Y轴
	channel@1 {
		reg = <1>;
		zephyr,gain = "ADC_GAIN_1_5";
		zephyr,reference = "ADC_REF_INTERNAL";
		zephyr,acquisition-time = <ADC_ACQ_TIME(ADC_ACQ_TIME_MICROSECONDS, 40)>;
		zephyr,resolution = <12>;
		zephyr,input-positive = <NRF_SAADC_AIN1>;  // P0.03
		label = "JOYSTICK_Y";
	};
	
	// 通道2: 电池电压检测
	channel@2 {
		reg = <2>;
		zephyr,gain = "ADC_GAIN_1_5";
		zephyr,reference = "ADC_REF_INTERNAL";
		zephyr,acquisition-time = <ADC_ACQ_TIME(ADC_ACQ_TIME_MICROSECONDS, 40)>;
		zephyr,resolution = <12>;
		zephyr,input-positive = <NRF_SAADC_AIN2>;  // P0.04
		label = "BATTERY";
	};
};