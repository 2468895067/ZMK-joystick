&behavior_joystick_to_keys {
    compatible = "zmk,behavior-joystick-to-keys";
    label = "JOYSTICK -> WASD";

    #x-axis-threshold = <3000>;  // 阈值，X 轴值大于此值时才会触发按键
    #y-axis-threshold = <3000>;  // 阈值，Y 轴值大于此值时才会触发按键

    w_key = <&kp W>;  // 向上时触发 W 键
    a_key = <&kp A>;  // 向左时触发 A 键
    s_key = <&kp S>;  // 向下时触发 S 键
    d_key = <&kp D>;  // 向右时触发 D 键

    // 控制是否需要反转
    x-invert;
    y-invert;

    // 添加一个死区（让摇杆在中心附近的微小偏移不被识别）
    deadzone = <200>;
};
